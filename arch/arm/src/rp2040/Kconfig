## boards/arm/rp2040/raspberrypi-pico/Kconfig
```kconfig
#
# For a description of the syntax of this configuration file,
# see the file kconfig-language.txt in the NuttX tools repository.
#

if ARCH_BOARD_RASPBERRYPI_PICO

config RP2040_FLASH_BOOT
	bool "flash boot"
	default n

config RP2040_UF2_BINARY
	bool "uf2 binary format"
	default y
	---help---
		Create nuttx.uf2 binary format used on RP2040 based arch.

endif
```
